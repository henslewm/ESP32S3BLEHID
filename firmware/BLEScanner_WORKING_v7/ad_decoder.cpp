// Generated by scripts/split_v7_sketch.py from the locked v7 baseline; edit freely.
#include "ad_decoder.h"
#include "ble_format.h"

// Specialized payload decoders
// ============================================================================

static void decodeIBeacon(const uint8_t* manufacturerPayload, size_t len) {
  // Apple manufacturer payload after Company ID:
  // 02 15 | UUID(16) | major(2) | minor(2) | measured power(1)
  if (len < 23) return;
  if (manufacturerPayload[0] != 0x02 || manufacturerPayload[1] != 0x15) return;

  Serial.print("    iBeacon UUID=");

  const uint8_t* u = manufacturerPayload + 2;

  for (int i = 0; i < 16; ++i) {
    Serial.printf("%02X", u[i]);

    if (i == 3 || i == 5 || i == 7 || i == 9) {
      Serial.write('-');
    }
  }

  const uint16_t major = be16(manufacturerPayload + 18);
  const uint16_t minor = be16(manufacturerPayload + 20);
  const int8_t measuredPower = (int8_t)manufacturerPayload[22];

  Serial.printf(" major=%u minor=%u measuredPower=%d_dBm\n",
                (unsigned)major,
                (unsigned)minor,
                (int)measuredPower);
}

static const char* eddystoneUrlScheme(uint8_t code) {
  switch (code) {
    case 0x00: return "http://www.";
    case 0x01: return "https://www.";
    case 0x02: return "http://";
    case 0x03: return "https://";
    default: return nullptr;
  }
}

static const char* eddystoneUrlExpansion(uint8_t code) {
  switch (code) {
    case 0x00: return ".com/";
    case 0x01: return ".org/";
    case 0x02: return ".edu/";
    case 0x03: return ".net/";
    case 0x04: return ".info/";
    case 0x05: return ".biz/";
    case 0x06: return ".gov/";
    case 0x07: return ".com";
    case 0x08: return ".org";
    case 0x09: return ".edu";
    case 0x0A: return ".net";
    case 0x0B: return ".info";
    case 0x0C: return ".biz";
    case 0x0D: return ".gov";
    default: return nullptr;
  }
}

static void decodeEddystone(const uint8_t* data, size_t len) {
  if (len < 1) return;

  switch (data[0]) {
    case 0x00: { // UID
      if (len < 18) return;

      Serial.printf("    Eddystone-UID tx=%d namespace=", (int8_t)data[1]);
      printHex(data + 2, 10);
      Serial.print(" instance=");
      printHex(data + 12, 6);
      Serial.println();
      break;
    }

    case 0x10: { // URL
      if (len < 3) return;

      Serial.printf("    Eddystone-URL tx=%d url=", (int8_t)data[1]);

      const char* scheme = eddystoneUrlScheme(data[2]);

      if (scheme) {
        Serial.print(scheme);
      } else {
        Serial.printf("<scheme:%02X>", data[2]);
      }

      for (size_t i = 3; i < len; ++i) {
        const char* expansion = eddystoneUrlExpansion(data[i]);

        if (expansion) {
          Serial.print(expansion);
        } else if (data[i] >= 32 && data[i] <= 126) {
          Serial.write(data[i]);
        } else {
          Serial.printf("\\x%02X", data[i]);
        }
      }

      Serial.println();
      break;
    }

    case 0x20: { // TLM
      if (len < 14) return;

      const uint8_t version = data[1];
      const uint16_t battMv = be16(data + 2);
      const int16_t tempRaw = (int16_t)be16(data + 4);
      const float tempC = (float)tempRaw / 256.0f;
      const uint32_t advCount = be32(data + 6);
      const uint32_t deciSeconds = be32(data + 10);

      Serial.printf(
          "    Eddystone-TLM v=%u batt=%u_mV temp=%.2f_C advCount=%lu uptime=%.1f_s\n",
          (unsigned)version,
          (unsigned)battMv,
          tempC,
          (unsigned long)advCount,
          deciSeconds / 10.0f);
      break;
    }

    case 0x30: { // EID
      if (len < 10) return;

      Serial.printf("    Eddystone-EID tx=%d eid=", (int8_t)data[1]);
      printHex(data + 2, 8);
      Serial.println();
      break;
    }

    default:
      Serial.printf("    Eddystone frame=0x%02X raw=", data[0]);
      printHex(data, len);
      Serial.println();
      break;
  }
}

// ============================================================================
// AD-structure parsing / identity extraction
// ============================================================================

static void copyName(DeviceStats& s, const uint8_t* d, size_t len) {
  if (len == 0) return;

  size_t n = len;
  if (n > sizeof(s.name) - 1) {
    n = sizeof(s.name) - 1;
  }

  for (size_t i = 0; i < n; ++i) {
    const uint8_t c = d[i];
    s.name[i] = (c >= 32 && c <= 126) ? (char)c : '.';
  }

  s.name[n] = '\0';
  s.hasName = true;
}

void extractIdentity(DeviceStats& s, const uint8_t* p, size_t len) {
  size_t i = 0;

  while (i < len) {
    const uint8_t fieldLen = p[i];

    if (fieldLen == 0) break;

    const size_t end = i + 1u + fieldLen;

    if (fieldLen < 1 || end > len) break;

    const uint8_t type = p[i + 1];
    const uint8_t* d = p + i + 2;
    const size_t dlen = fieldLen - 1;

    switch (type) {
      case 0x08:
        if (!s.hasName && dlen > 0) {
          copyName(s, d, dlen);
        }
        break;

      case 0x09:
        if (dlen > 0) {
          copyName(s, d, dlen);
        }
        break;

      case 0x0A:
        if (dlen >= 1) {
          s.txPower = (int8_t)d[0];
          s.hasTxPower = true;
        }
        break;

      case 0x19:
        if (dlen >= 2) {
          s.appearance = le16(d);
          s.hasAppearance = true;
        }
        break;

      case 0xFF:
        if (dlen >= 2) {
          s.companyId = le16(d);
          s.hasCompany = true;
        }
        break;

      default:
        break;
    }

    i = end;
  }
}

static void decodeFlags(uint8_t f) {
  Serial.printf("0x%02X[", f);

  bool first = true;

  auto add = [&](const char* s) {
    if (!first) Serial.print(",");
    Serial.print(s);
    first = false;
  };

  if (f & 0x01) add("limited_disc");
  if (f & 0x02) add("general_disc");
  if (f & 0x04) add("BR_EDR_not_supported");
  if (f & 0x08) add("simul_LE_BR_EDR_controller");
  if (f & 0x10) add("simul_LE_BR_EDR_host");

  Serial.print("]");
}

void decodeAD(const uint8_t* p, size_t len) {
  size_t i = 0;

  while (i < len) {
    const uint8_t fieldLen = p[i];

    if (fieldLen == 0) {
      break;
    }

    const size_t end = i + 1u + fieldLen;

    if (fieldLen < 1 || end > len) {
      Serial.printf("  AD malformed offset=%u fieldLen=%u remaining=%u\n",
                    (unsigned)i,
                    (unsigned)fieldLen,
                    (unsigned)(len - i));
      break;
    }

    const uint8_t type = p[i + 1];
    const uint8_t* d = p + i + 2;
    const size_t dlen = fieldLen - 1;

    Serial.printf("  AD type=0x%02X len=%u ", type, (unsigned)dlen);

    switch (type) {
      case 0x01:
        Serial.print("Flags=");
        if (dlen >= 1) decodeFlags(d[0]);
        break;

      case 0x02:
        Serial.print("UUID16_incomplete=");
        printUUID16List(d, dlen);
        break;

      case 0x03:
        Serial.print("UUID16=");
        printUUID16List(d, dlen);
        break;

      case 0x04:
        Serial.print("UUID32_incomplete=");
        printUUID32List(d, dlen);
        break;

      case 0x05:
        Serial.print("UUID32=");
        printUUID32List(d, dlen);
        break;

      case 0x06:
      case 0x07: {
        Serial.print(type == 0x07 ? "UUID128=" : "UUID128_incomplete=");

        bool first = true;

        for (size_t x = 0; x + 15 < dlen; x += 16) {
          if (!first) Serial.print(", ");
          printUUID128(d + x);
          first = false;
        }
        break;
      }

      case 0x08:
        Serial.print("ShortName=");
        printEscapedText(d, dlen);
        break;

      case 0x09:
        Serial.print("Name=");
        printEscapedText(d, dlen);
        break;

      case 0x0A:
        if (dlen >= 1) {
          Serial.printf("AdvTxPower=%d_dBm", (int8_t)d[0]);
        }
        break;

      case 0x12:
        if (dlen >= 4) {
          Serial.printf("ConnIntervalRange min=0x%04X max=0x%04X",
                        le16(d),
                        le16(d + 2));
        }
        break;

      case 0x14:
        Serial.print("SolicitUUID16=");
        printUUID16List(d, dlen);
        break;

      case 0x15:
        Serial.print("SolicitUUID128=");

        for (size_t x = 0; x + 15 < dlen; x += 16) {
          if (x) Serial.print(", ");
          printUUID128(d + x);
        }
        break;

      case 0x16: {
        if (dlen >= 2) {
          const uint16_t uuid = le16(d);

          Serial.printf("ServiceData16 UUID=0x%04X", uuid);

          if (const char* n = uuid16Name(uuid)) {
            Serial.print("(");
            Serial.print(n);
            Serial.print(")");
          }

          Serial.print(" data=");
          printHex(d + 2, dlen - 2);
          Serial.println();

          if (uuid == 0xFEAA) {
            decodeEddystone(d + 2, dlen - 2);
          }

          i = end;
          continue;
        }
        break;
      }

      case 0x17:
        Serial.print("PublicTargetAddress=");
        printHex(d, dlen);
        break;

      case 0x18:
        Serial.print("RandomTargetAddress=");
        printHex(d, dlen);
        break;

      case 0x19:
        if (dlen >= 2) {
          Serial.printf("Appearance=0x%04X", le16(d));
        }
        break;

      case 0x1A:
        if (dlen >= 2) {
          const uint16_t n = le16(d);

          Serial.printf("AdvertisingInterval=%u_units %.3f_ms",
                        (unsigned)n,
                        n * 0.625f);
        }
        break;

      case 0x1B:
        Serial.print("LE_Device_Address=");
        printHex(d, dlen);
        break;

      case 0x1C:
        if (dlen >= 1) {
          Serial.printf("LE_Role=0x%02X", d[0]);
        }
        break;

      case 0x1F:
        Serial.print("SolicitUUID32=");
        printUUID32List(d, dlen);
        break;

      case 0x20:
        if (dlen >= 4) {
          Serial.printf("ServiceData32 UUID=0x%08lX data=",
                        (unsigned long)le32(d));
          printHex(d + 4, dlen - 4);
        }
        break;

      case 0x21:
        if (dlen >= 16) {
          Serial.print("ServiceData128 UUID=");
          printUUID128(d);
          Serial.print(" data=");
          printHex(d + 16, dlen - 16);
        }
        break;

      case 0x24:
        Serial.print("URI_encoded=");
        printHex(d, dlen);
        break;

      case 0x27:
        Serial.print("LE_Supported_Features=");
        printHex(d, dlen);
        break;

      case 0x30:
        Serial.print("BroadcastName=");
        printEscapedText(d, dlen);
        break;

      case 0x31:
        Serial.print("EncryptedAdvertisingData=");
        printHex(d, dlen);
        break;

      case 0xFF: {
        if (dlen >= 2) {
          const uint16_t companyId = le16(d);

          Serial.printf("Manufacturer CompanyID=0x%04X", companyId);

          if (const char* company = companyName(companyId)) {
            Serial.print("(");
            Serial.print(company);
            Serial.print(")");
          }

          Serial.print(" data=");
          printHex(d + 2, dlen - 2);
          Serial.println();

          if (companyId == 0x004C) {
            decodeIBeacon(d + 2, dlen - 2);
          }

          i = end;
          continue;
        }

        Serial.print("ManufacturerData=");
        printHex(d, dlen);
        break;
      }

      default:
        Serial.print("Raw=");
        printHex(d, dlen);
        break;
    }

    Serial.println();
    i = end;
  }
}
