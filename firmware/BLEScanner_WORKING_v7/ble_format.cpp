// Generated by scripts/split_v7_sketch.py from the locked v7 baseline; edit freely.
#include "ble_format.h"

// Address helpers
// ============================================================================

bool sameAddress(const uint8_t* a, const uint8_t* b) {
  return memcmp(a, b, 6) == 0;
}

void printAddress(const uint8_t* nativeAddr) {
  // NimBLE stores native bytes in reverse display order.
  Serial.printf("%02X:%02X:%02X:%02X:%02X:%02X",
                nativeAddr[5], nativeAddr[4], nativeAddr[3],
                nativeAddr[2], nativeAddr[1], nativeAddr[0]);
}

const char* addrTypeName(uint8_t t) {
  switch (t) {
    case 0: return "public";
    case 1: return "random";
    case 2: return "public_identity";
    case 3: return "random_identity";
    default: return "unknown";
  }
}

const char* randomAddrSubtype(const uint8_t* nativeAddr, uint8_t addrType) {
  if (addrType != 1 && addrType != 3) {
    return "n/a";
  }

  // Display-order MSB is nativeAddr[5] for NimBLE.
  switch ((nativeAddr[5] >> 6) & 0x03) {
    case 0x03: return "static_random";
    case 0x01: return "resolvable_private";
    case 0x00: return "non_resolvable_private";
    default:   return "reserved_random";
  }
}

// ============================================================================
// Generic helpers
// ============================================================================

void printHex(const uint8_t* data, size_t len) {
  static const char hex[] = "0123456789ABCDEF";

  for (size_t i = 0; i < len; ++i) {
    Serial.write(hex[(data[i] >> 4) & 0x0F]);
    Serial.write(hex[data[i] & 0x0F]);
  }
}

uint16_t le16(const uint8_t* p) {
  return (uint16_t)p[0] | ((uint16_t)p[1] << 8);
}

uint32_t le32(const uint8_t* p) {
  return ((uint32_t)p[0]) |
         ((uint32_t)p[1] << 8) |
         ((uint32_t)p[2] << 16) |
         ((uint32_t)p[3] << 24);
}

uint16_t be16(const uint8_t* p) {
  return ((uint16_t)p[0] << 8) | (uint16_t)p[1];
}

uint32_t be32(const uint8_t* p) {
  return ((uint32_t)p[0] << 24) |
         ((uint32_t)p[1] << 16) |
         ((uint32_t)p[2] << 8) |
         (uint32_t)p[3];
}

uint32_t fnv1a32(const uint8_t* data, size_t len) {
  uint32_t h = 2166136261UL;

  for (size_t i = 0; i < len; ++i) {
    h ^= data[i];
    h *= 16777619UL;
  }

  return h;
}

void printEscapedText(const uint8_t* data, size_t len) {
  Serial.write('"');

  for (size_t i = 0; i < len; ++i) {
    const uint8_t c = data[i];

    if (c == '"' || c == '\\') {
      Serial.write('\\');
      Serial.write(c);
    } else if (c >= 32 && c <= 126) {
      Serial.write(c);
    } else {
      Serial.printf("\\x%02X", c);
    }
  }

  Serial.write('"');
}

void printUUID128(const uint8_t* d) {
  // BLE advertising UUID values are transmitted least-significant octet first.
  for (int i = 15; i >= 0; --i) {
    Serial.printf("%02X", d[i]);

    if (i == 12 || i == 10 || i == 8 || i == 6) {
      Serial.write('-');
    }
  }
}

const char* uuid16Name(uint16_t uuid) {
  switch (uuid) {
    case 0x1800: return "Generic Access";
    case 0x1801: return "Generic Attribute";
    case 0x1802: return "Immediate Alert";
    case 0x1803: return "Link Loss";
    case 0x1804: return "Tx Power";
    case 0x1805: return "Current Time";
    case 0x180A: return "Device Information";
    case 0x180D: return "Heart Rate";
    case 0x180F: return "Battery Service";
    case 0x1812: return "Human Interface Device";
    case 0x181A: return "Environmental Sensing";
    case 0x181C: return "User Data";
    case 0x181D: return "Weight Scale";
    case 0x1826: return "Fitness Machine";
    case 0x1827: return "Mesh Provisioning";
    case 0x1828: return "Mesh Proxy";
    case 0x1848: return "Media Control";
    case 0xFD6F: return "Exposure Notification";
    case 0xFEAA: return "Eddystone";
    default: return nullptr;
  }
}

const char* companyName(uint16_t id) {
  // Small, conservative subset of Bluetooth SIG Company Identifiers.
  switch (id) {
    case 0x0002: return "Intel";
    case 0x0006: return "Microsoft";
    case 0x004C: return "Apple";
    case 0x0059: return "Nordic Semiconductor";
    case 0x00E0: return "Google";
    case 0x02E5: return "Espressif";
    default: return nullptr;
  }
}

void printUUID16List(const uint8_t* d, size_t len) {
  bool first = true;

  for (size_t i = 0; i + 1 < len; i += 2) {
    const uint16_t uuid = le16(d + i);

    if (!first) Serial.print(", ");

    Serial.printf("0x%04X", uuid);

    if (const char* n = uuid16Name(uuid)) {
      Serial.print("(");
      Serial.print(n);
      Serial.print(")");
    }

    first = false;
  }
}

void printUUID32List(const uint8_t* d, size_t len) {
  bool first = true;

  for (size_t i = 0; i + 3 < len; i += 4) {
    if (!first) Serial.print(", ");

    Serial.printf("0x%08lX", (unsigned long)le32(d + i));
    first = false;
  }
}

// ============================================================================
// Advertising event type
// ============================================================================

const char* advTypeName(uint8_t t) {
  switch (t) {
    case BLE_HCI_ADV_RPT_EVTYPE_ADV_IND:     return "ADV_IND";
    case BLE_HCI_ADV_RPT_EVTYPE_DIR_IND:    return "ADV_DIRECT_IND";
    case BLE_HCI_ADV_RPT_EVTYPE_SCAN_IND:   return "ADV_SCAN_IND";
    case BLE_HCI_ADV_RPT_EVTYPE_NONCONN_IND:return "ADV_NONCONN_IND";
    case BLE_HCI_ADV_RPT_EVTYPE_SCAN_RSP:   return "SCAN_RSP";
    default: return "UNKNOWN";
  }
}

// ============================================================================
