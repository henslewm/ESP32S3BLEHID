// Generated by scripts/split_v7_sketch.py from the locked v7 baseline; edit freely.
#include "device_stats.h"
#include "ble_format.h"
#include "ad_decoder.h"
#include "packet_queue.h"
#include "scanner.h"
#include "hid_mode.h"

DeviceStats g_stats[MAX_TRACKED];
uint64_t g_totalReports = 0;
uint32_t g_statsDrops = 0;
uint32_t g_lastSummaryMs = 0;

// ============================================================================
// Statistics
// ============================================================================

static DeviceStats* findStats(const PacketSnapshot& p) {
  for (size_t i = 0; i < MAX_TRACKED; ++i) {
    if (!g_stats[i].used) continue;

    if (g_stats[i].addrType == p.addrType &&
        sameAddress(g_stats[i].addrNative, p.addrNative)) {
      return &g_stats[i];
    }
  }

  return nullptr;
}

static DeviceStats* findOrCreateStats(const PacketSnapshot& p) {
  if (DeviceStats* existing = findStats(p)) {
    return existing;
  }

  for (size_t i = 0; i < MAX_TRACKED; ++i) {
    if (g_stats[i].used) continue;

    DeviceStats& s = g_stats[i];
    memset(&s, 0, sizeof(s));

    s.used = true;
    memcpy(s.addrNative, p.addrNative, 6);
    s.addrType = p.addrType;

    s.firstSeenMs = p.receivedMs;
    s.lastSeenMs = p.receivedMs;
    s.lastArrivalMs = p.receivedMs;

    s.minRssi = p.rssi;
    s.maxRssi = p.rssi;
    s.minIntervalMs = UINT32_MAX;

    return &s;
  }

  ++g_statsDrops;
  return nullptr;
}

static void updateStats(DeviceStats& s, const PacketSnapshot& p) {
  ++s.reports;
  s.lastSeenMs = p.receivedMs;

  s.connectable = s.connectable || p.connectable;
  s.scannable = s.scannable || p.scannable;

  if (p.rssi != 127) {
    if (p.rssi < s.minRssi) s.minRssi = p.rssi;
    if (p.rssi > s.maxRssi) s.maxRssi = p.rssi;

    ++s.rssiSamples;

    const double delta = (double)p.rssi - s.meanRssi;
    s.meanRssi += delta / (double)s.rssiSamples;
    const double delta2 = (double)p.rssi - s.meanRssi;
    s.m2Rssi += delta * delta2;
  }

  if (s.reports > 1) {
    const uint32_t dt = p.receivedMs - s.lastArrivalMs;

    if (dt < s.minIntervalMs) s.minIntervalMs = dt;
    if (dt > s.maxIntervalMs) s.maxIntervalMs = dt;

    ++s.intervalSamples;

    const double delta = (double)dt - s.meanIntervalMs;
    s.meanIntervalMs += delta / (double)s.intervalSamples;
  }

  s.lastArrivalMs = p.receivedMs;

  switch (p.advType) {
    case BLE_HCI_ADV_RPT_EVTYPE_ADV_IND:
      ++s.advIndCount;
      break;

    case BLE_HCI_ADV_RPT_EVTYPE_DIR_IND:
      ++s.advDirectCount;
      break;

    case BLE_HCI_ADV_RPT_EVTYPE_SCAN_IND:
      ++s.advScanCount;
      break;

    case BLE_HCI_ADV_RPT_EVTYPE_NONCONN_IND:
      ++s.advNonConnCount;
      break;

    case BLE_HCI_ADV_RPT_EVTYPE_SCAN_RSP:
      ++s.scanRspCount;
      break;

    default:
      ++s.otherAdvCount;
      break;
  }

  const uint32_t fingerprint = fnv1a32(p.payload, p.payloadLen);

  if (s.reports > 1 &&
      s.lastFingerprint != 0 &&
      fingerprint != s.lastFingerprint) {
    ++s.payloadChanges;
  }

  s.lastFingerprint = fingerprint;

  extractIdentity(s, p.payload, p.payloadLen);
}

// ============================================================================
// Packet processing / display
// ============================================================================

void processPacket(const PacketSnapshot& p) {
  ++g_totalReports;

  DeviceStats* s = findOrCreateStats(p);
  if (!s) return;

  updateStats(*s, p);

  if (!g_verbosePackets) return;
  if (p.rssi != 127 && p.rssi < g_printRssiFloor) return;

  Serial.println();
  Serial.println("----- BLE / NimBLE REPORT -----");

  Serial.printf("t_ms=%lu report=%llu addr=",
                (unsigned long)p.receivedMs,
                (unsigned long long)g_totalReports);

  printAddress(p.addrNative);

  Serial.printf(" addr_type=%u(%s) subtype=%s",
                (unsigned)p.addrType,
                addrTypeName(p.addrType),
                randomAddrSubtype(p.addrNative, p.addrType));

  if (p.rssi == 127) {
    Serial.print(" rssi=NA");
  } else {
    Serial.printf(" rssi=%d_dBm", (int)p.rssi);
  }

  Serial.printf(" adv_type=%u(%s) connectable=%s scannable=%s legacy=%s",
                (unsigned)p.advType,
                advTypeName(p.advType),
                p.connectable ? "yes" : "no",
                p.scannable ? "yes" : "no",
                p.legacy ? "yes" : "no");

  Serial.printf(" payload_len=%u fingerprint=0x%08lX",
                (unsigned)p.payloadLen,
                (unsigned long)fnv1a32(p.payload, p.payloadLen));

  if (p.payloadTruncated) {
    Serial.print(" local_capture_truncated=yes");
  }

  if (s->hasName) {
    Serial.print(" name=\"");
    Serial.print(s->name);
    Serial.print("\"");
  }

  if (s->hasCompany) {
    Serial.printf(" company_id=0x%04X", s->companyId);

    if (const char* company = companyName(s->companyId)) {
      Serial.print("(");
      Serial.print(company);
      Serial.print(")");
    }
  }

  if (s->hasTxPower) {
    Serial.printf(" adv_tx=%d_dBm", (int)s->txPower);
  }

  if (s->hasAppearance) {
    Serial.printf(" appearance=0x%04X", s->appearance);
  }

  Serial.println();

  if (g_printRaw) {
    Serial.print("raw=");
    printHex(p.payload, p.payloadLen);
    Serial.println();
  }

  if (g_decodeAD && p.payloadLen > 0) {
    decodeAD(p.payload, p.payloadLen);
  }
}

// ============================================================================
// Summary
// ============================================================================

void printSummary() {
  const uint32_t now = millis();
  size_t tracked = 0;

  Serial.println();
  Serial.println("================ NIMBLE RESEARCH SUMMARY ================");

  Serial.printf("stack=%s scanning=%s active=%s duplicates=%s slices=%lu hid_mode=%s\n",
                BLEDevice::getBLEStackString().c_str(),
                g_scan->isScanning() ? "yes" : "no",
                g_activeScan ? "yes" : "no",
                g_keepDuplicates ? "kept" : "filtered",
                (unsigned long)g_scanSlices,
                g_hidMode ? (g_hidConnected ? "connected" : "advertising") : "off");

  Serial.printf(
      "reports=%llu queue_drops=%lu stats_drops=%lu scan_start_failures=%lu\n",
      (unsigned long long)g_totalReports,
      (unsigned long)g_queueDrops,
      (unsigned long)g_statsDrops,
      (unsigned long)g_scanStartFailures);

  Serial.printf("heap_free=%u heap_min=%u psram_total=%u psram_free=%u\n",
                (unsigned)ESP.getFreeHeap(),
                (unsigned)ESP.getMinFreeHeap(),
                (unsigned)ESP.getPsramSize(),
                (unsigned)ESP.getFreePsram());

  for (size_t i = 0; i < MAX_TRACKED; ++i) {
    const DeviceStats& s = g_stats[i];

    if (!s.used) continue;

    ++tracked;

    double rssiSd = 0.0;

    if (s.rssiSamples > 1) {
      rssiSd = sqrt(s.m2Rssi / (double)(s.rssiSamples - 1));
    }

    Serial.print("addr=");
    printAddress(s.addrNative);

    Serial.printf(
        " type=%s/%s reports=%llu changes=%lu conn=%s scan=%s",
        addrTypeName(s.addrType),
        randomAddrSubtype(s.addrNative, s.addrType),
        (unsigned long long)s.reports,
        (unsigned long)s.payloadChanges,
        s.connectable ? "yes" : "no",
        s.scannable ? "yes" : "no");

    Serial.printf(" rssi[min/mean/max/sd]=%d/%.1f/%d/%.1f",
                  (int)s.minRssi,
                  s.meanRssi,
                  (int)s.maxRssi,
                  rssiSd);

    if (s.intervalSamples > 0) {
      Serial.printf(" cadence[min/mean/max]=%lu/%.1f/%lu_ms",
                    (unsigned long)s.minIntervalMs,
                    s.meanIntervalMs,
                    (unsigned long)s.maxIntervalMs);
    }

    Serial.printf(
        " evt[adv=%lu dir=%lu scan=%lu nonconn=%lu rsp=%lu other=%lu]",
        (unsigned long)s.advIndCount,
        (unsigned long)s.advDirectCount,
        (unsigned long)s.advScanCount,
        (unsigned long)s.advNonConnCount,
        (unsigned long)s.scanRspCount,
        (unsigned long)s.otherAdvCount);

    if (s.hasCompany) {
      Serial.printf(" company=0x%04X", s.companyId);

      if (const char* company = companyName(s.companyId)) {
        Serial.print("(");
        Serial.print(company);
        Serial.print(")");
      }
    }

    if (s.hasName) {
      Serial.print(" name=\"");
      Serial.print(s.name);
      Serial.print("\"");
    }

    if (s.hasTxPower) {
      Serial.printf(" tx=%d_dBm", (int)s.txPower);
    }

    Serial.printf(" age=%lu_ms fp=%08lX\n",
                  (unsigned long)(now - s.lastSeenMs),
                  (unsigned long)s.lastFingerprint);
  }

  Serial.printf(
      "tracked=%u/%u rssi_print_floor=%d verbose=%s raw=%s decode=%s\n",
      (unsigned)tracked,
      (unsigned)MAX_TRACKED,
      (int)g_printRssiFloor,
      g_verbosePackets ? "on" : "off",
      g_printRaw ? "on" : "off",
      g_decodeAD ? "on" : "off");

  Serial.println("=========================================================");
}

void clearResearchStats() {
  memset(g_stats, 0, sizeof(g_stats));

  g_totalReports = 0;
  g_statsDrops = 0;

  clearPacketQueue();

  Serial.println("Research statistics and packet queue cleared.");
}
