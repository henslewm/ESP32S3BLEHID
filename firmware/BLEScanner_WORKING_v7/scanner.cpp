// Generated by scripts/split_v7_sketch.py from the locked v7 baseline; edit freely.
#include "scanner.h"
#include "packet_queue.h"
#include "hid_mode.h"

bool g_activeScan      = true;
bool g_keepDuplicates = true;
bool g_verbosePackets  = false;
bool g_printRaw        = false;
bool g_decodeAD        = true;
bool g_paused          = true;
int8_t g_printRssiFloor = -127;
bool g_autoSummary     = false;

BLEScan* g_scan = nullptr;
volatile bool g_scanSliceEnded = false;
uint32_t g_scanSlices = 0;
uint32_t g_scanStartFailures = 0;

// ============================================================================
// BLE callbacks
// ============================================================================

class ResearchAdvertisedDeviceCallbacks : public BLEAdvertisedDeviceCallbacks {
 public:
  void onResult(BLEAdvertisedDevice advertisedDevice) override {
    PacketSnapshot p = {};

    BLEAddress address = advertisedDevice.getAddress();
    memcpy(p.addrNative, address.getNative(), 6);

    p.addrType = advertisedDevice.getAddressType();
    p.rssi = advertisedDevice.getRSSI();
    p.advType = advertisedDevice.getAdvType();

    p.connectable = advertisedDevice.isConnectable();
    p.scannable = advertisedDevice.isScannable();
    p.legacy = advertisedDevice.isLegacyAdvertisement();

    p.receivedMs = millis();

    const uint8_t* raw = advertisedDevice.getPayload();
    const size_t rawLen = advertisedDevice.getPayloadLength();

    size_t copyLen = rawLen;
    if (copyLen > MAX_CAPTURE_PAYLOAD) {
      copyLen = MAX_CAPTURE_PAYLOAD;
      p.payloadTruncated = true;
    }

    if (raw != nullptr && copyLen > 0) {
      memcpy(p.payload, raw, copyLen);
    }

    p.payloadLen = (uint16_t)copyLen;

    // Do not print/parse here. This callback runs in the BLE host context.
    enqueuePacket(p);
  }
};

static ResearchAdvertisedDeviceCallbacks g_callbacks;

static void scanComplete(BLEScanResults results) {
  // Keep the completion callback tiny; restart happens from loop().
  (void)results;
  g_scanSliceEnded = true;
}

// ============================================================================
// Scanner control
// ============================================================================

bool startScanSlice() {
  if (g_paused) return false;

  // IMPORTANT:
  // wantDuplicates=true keeps repeat reports.
  // shouldParse=false makes Arduino replace each ADV payload and append only its
  // matching Scan Response instead of repeatedly appending duplicate payloads.
  g_scan->setAdvertisedDeviceCallbacks(&g_callbacks, g_keepDuplicates, false);

  g_scan->setActiveScan(g_activeScan);
  g_scan->setInterval(SCAN_INTERVAL_MS);
  g_scan->setWindow(SCAN_WINDOW_MS);

  // Explicit NimBLE duplicate-filter control.
  g_scan->setDuplicateFilter(!g_keepDuplicates);

  g_scanSliceEnded = false;

  const bool ok = g_scan->start(SCAN_SLICE_SECONDS, scanComplete, false);

  if (ok) {
    ++g_scanSlices;
  } else {
    ++g_scanStartFailures;
  }

  return ok;
}

void stopScanner() {
  g_paused = true;

  if (g_scan->isScanning()) {
    g_scan->stop();
  }

  // stop() may invoke scanComplete(), so discard that restart request.
  g_scanSliceEnded = false;
}

void resumeScanner() {
  if (g_scan->isScanning()) return;

  // Leaving HID mode first keeps one radio role active at a time.
  if (g_hidMode) {
    stopHidMode();
  }

  g_paused = false;
  g_scan->clearResults();

  startScanSlice();
}

void restartScanner() {
  const bool wasPaused = g_paused;

  if (g_scan->isScanning()) {
    g_scan->stop();
  }

  g_scanSliceEnded = false;

  g_scan->clearResults();

  if (!wasPaused) {
    g_paused = false;
    startScanSlice();
  }
}

void startPreset(bool active, bool verbose) {
  // Leaving HID mode first keeps one radio role active at a time.
  if (g_hidMode) {
    stopHidMode();
  }

  g_activeScan = active;
  g_verbosePackets = verbose;
  g_printRaw = false;
  g_decodeAD = true;

  if (g_scan->isScanning()) {
    g_scan->stop();
  }

  g_scanSliceEnded = false;
  g_scan->clearResults();

  g_paused = false;

  Serial.printf("Starting %s scan (%s output)...\n",
                g_activeScan ? "ACTIVE" : "PASSIVE",
                g_verbosePackets ? "verbose" : "quiet");

  if (!startScanSlice()) {
    Serial.println("ERROR: scan failed to start.");
  }
}
