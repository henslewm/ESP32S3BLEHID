// Generated by scripts/split_v7_sketch.py from the locked v7 baseline; edit freely.
#include "hid_mode.h"
#include "hid_report_map.h"
#include "scanner.h"
#include "hid_diag.h"
#include "hid_core_workaround.h"

bool g_hidMode = false;      // 'b' entered HID mode
static bool g_hidBuilt = false;     // HID server has been constructed once
bool g_hidConnected = false;
static BLEServer* g_hidServer = nullptr;
static BLEHIDDevice* g_hid = nullptr;
static BLECharacteristic* g_keyboardInput = nullptr;
static BLECharacteristic* g_mouseInput = nullptr;
volatile bool g_keyboardSubscribed = false;
volatile bool g_mouseSubscribed = false;

// ============================================================================
// Forward declarations for safe HID state cleanup.
static bool sendNeutralKeyboardReport();
static bool sendNeutralMouseReport();
static void releaseAllHidInputs();
// Track the actual HID CCCD subscription state. A BLE connection alone is
// not enough to prove that Windows is ready to accept input reports.
class HidInputCallbacks : public BLECharacteristicCallbacks {
 public:
#if defined(CONFIG_NIMBLE_ENABLED)
  void onSubscribe(BLECharacteristic* characteristic,
                   ble_gap_conn_desc* desc,
                   uint16_t subValue) override {
    (void)desc;
    const bool notifyEnabled = (subValue & 0x0001) != 0;
    if (characteristic == g_keyboardInput) {
      g_keyboardSubscribed = notifyEnabled;
      Serial.printf("[HID] keyboard notifications: %s\n",
                    notifyEnabled ? "SUBSCRIBED" : "off");
    } else if (characteristic == g_mouseInput) {
      g_mouseSubscribed = notifyEnabled;
      Serial.printf("[HID] mouse notifications: %s\n",
                    notifyEnabled ? "SUBSCRIBED" : "off");
    }
    Serial.flush();
  }
#endif
};
static HidInputCallbacks g_hidInputCallbacks;

// HID server callbacks (connection events logged for detection correlation)
// ============================================================================

class HidServerCallbacks : public BLEServerCallbacks {
 public:
  void onConnect(BLEServer* server) override {
    (void)server;
    g_hidConnected = true;
    g_keyboardSubscribed = false;
    g_mouseSubscribed = false;
    Serial.println();
    Serial.println("[HID] Central CONNECTED. Pairing/bonding in progress.");
    Serial.println("[HID] Watch the Win11 target now: Defender history,");
    Serial.println("[HID] Sysmon events, and the Bluetooth devices list.");
  }

  void onDisconnect(BLEServer* server) override {
    (void)server;
    g_hidConnected = false;
    g_keyboardSubscribed = false;
    g_mouseSubscribed = false;
    Serial.println("[HID] Central disconnected.");
    // Re-advertise so a new pairing attempt can be made without a reboot.
    if (g_hidMode && server->getAdvertising() != nullptr) {
      server->getAdvertising()->start();
      Serial.println("[HID] Re-advertising.");
    }
  }
};

static HidServerCallbacks g_hidServerCallbacks;

// ============================================================================
// HID mode control
// ============================================================================

void startHidMode() {
  if (g_hidMode) {
    Serial.println("HID mode already active.");
    return;
  }

  // Scanner and HID roles cannot share the radio; pause scanning first.
  stopScanner();

  // Just Works pairing: bonding ON, MITM OFF, secure-connection OFF,
  // IO capability NoInputNoOutput. No PIN / user numeric comparison
  // is generated by this peripheral. (Windows may still show its own
  // consent for keyboard-class devices; that is host-side behavior.)
  BLESecurity::setAuthenticationMode(true, false, false);
  BLESecurity::setCapability(ESP_IO_CAP_NONE);

  if (!g_hidBuilt) {
    Serial.println("[HID] Building GATT/HID services...");
    g_hidServer = BLEDevice::createServer();
    if (g_hidServer == nullptr) {
      Serial.println("[HID] ERROR: BLEDevice::createServer() returned nullptr.");
      return;
    }
    g_hidServer->setCallbacks(&g_hidServerCallbacks);

    g_hid = new BLEHIDDevice(g_hidServer);

    // Generic-looking identity: no vendor-specific driver required.
    // Device name is set by BLEDevice::init(); BLEHIDDevice has no deviceName() API.
    // Arduino-ESP32 3.3.12 bug/workaround:
    // manufacturer(String) dereferences m_manufacturerCharacteristic before
    // manufacturer() has created that optional characteristic.
    BLECharacteristic* hidManufacturer = g_hid->manufacturer();
    if (hidManufacturer == nullptr) {
      Serial.println("[HID] ERROR: could not create Manufacturer Name characteristic.");
      return;
    }
    hidManufacturer->setValue("Espressif Systems");

    // PnP: generic USB-IF vendor, arbitrary product, so Windows loads the
    // in-box HID class driver. Change these if you want a different identity.
    g_hid->pnp(0x01, 0x02E5, 0x0001, 0x0007);

    g_hid->hidInfo(0x00, 0x01);

    // Report map = composite keyboard + mouse with report IDs 1 and 2.
    g_hid->reportMap(const_cast<uint8_t*>(HID_REPORT_MAP), HID_REPORT_MAP_LEN);

    // Boot-protocol support lets the device appear even more generic.
    g_keyboardInput = g_hid->inputReport(1);  // keyboard report ID
    // inputReport(2) would be silently dropped by the 3.3.12 core (duplicate UUID).
    g_mouseInput = hidAddInputReport(g_hid, 2);  // mouse report ID
    if (g_keyboardInput == nullptr || g_mouseInput == nullptr) {
      Serial.println("[HID] ERROR: failed to create HID input report characteristics.");
      return;
    }
    g_keyboardInput->setCallbacks(&g_hidInputCallbacks);
    g_mouseInput->setCallbacks(&g_hidInputCallbacks);
    g_hid->startServices();

    g_hidBuilt = true;
  }

  BLEAdvertising* adv = g_hidServer->getAdvertising();

  adv->addServiceUUID(g_hid->hidService()->getUUID());
  adv->setName("S3-HID-KM-v7");
  adv->setAppearance(0x03C0);  // Generic HID: composite keyboard + mouse
  adv->setScanResponse(true);
  adv->setMinPreferred(0x06);  // helps Windows enumerate parameters
  adv->setMaxPreferred(0x12);

  adv->start();
  hidDiagBegin(g_keyboardInput->getHandle(), g_mouseInput->getHandle());

  g_hidMode = true;

  Serial.println();
  Serial.println("[HID] Mode STARTED. Advertising as S3-HID-KM-v7 (Generic HID keyboard + mouse).");
  Serial.println("[HID] Pairing: Just Works (no PIN). Bonding enabled.");
  Serial.println("[HID] GAP appearance=0x03C0 Generic HID; PnP vendor source=Bluetooth SIG, vendor=0x02E5.");
  Serial.println("[HID] The scanner is paused. Use 1-4 to resume scanning,");
  Serial.println("[HID] or B to stop HID mode.");
  Serial.println("[HID] After the target pairs and connects, press t to");
  Serial.println("[HID] run the mouse-only notification diagnostic.");
}

void stopHidMode() {
  if (!g_hidMode) {
    Serial.println("HID mode not active.");
    return;
  }

  // Do not transmit keyboard reports here. Until the HID notification path
  // is proven stable, stopping HID mode must not be able to leave a modifier
  // key in an uncertain host state.
  if (g_mouseSubscribed && g_hidConnected && g_mouseInput != nullptr) {
    uint8_t neutralMouse[4] = {0x00, 0x00, 0x00, 0x00};
    g_mouseInput->setValue(neutralMouse, sizeof(neutralMouse));
    Serial.println("[HID] stop: sending neutral mouse report...");
    Serial.flush();
    g_mouseInput->notify();
    delay(50);
  }
  if (g_hidServer != nullptr && g_hidServer->getAdvertising() != nullptr) {
    g_hidServer->getAdvertising()->stop();
  }

  g_hidMode = false;  // before disconnecting, so onDisconnect does not re-advertise

  // Leaving HID mode must drop the host link too; stopping advertising alone
  // left Windows connected while this sketch reported connected=no.
  if (g_hidServer != nullptr) {
    for (auto& peer : g_hidServer->getPeerDevices(false)) {
      Serial.printf("[HID] stop: disconnecting conn=%u\n", (unsigned)peer.first);
      g_hidServer->disconnect(peer.first);
    }
  }

  g_hidConnected = false;
  g_keyboardSubscribed = false;
  g_mouseSubscribed = false;

  Serial.println();
  Serial.println("[HID] Mode STOPPED. HID advertising halted.");
  Serial.println("[HID] The scanner remains paused; use 1-4 to scan again.");
}

// HID-over-GATT report characteristics already identify the Report ID through
// their Report Reference descriptor (0x2908). The GATT characteristic VALUE
// must contain only the report payload, not the Report ID byte.
//
// Keyboard payload for report ID 1:
//   [modifiers][reserved][key0][key1][key2][key3][key4][key5] = 8 bytes
//
// Mouse payload for report ID 2:
//   [buttons][dx][dy][wheel] = 4 bytes
//
// The previous implementation incorrectly prepended 0x01 / 0x02 to those
// characteristic values. On Windows that shifts every field by one byte and
// can leave stale modifier/button state if the link drops before a neutral
// report arrives.
static bool sendNeutralKeyboardReport() {
  if (!g_hidMode || !g_hidConnected || g_keyboardInput == nullptr) {
    return false;
  }
  uint8_t neutralKeyboard[8] = {
    0x00, // modifiers
    0x00, // reserved
    0x00, 0x00, 0x00, 0x00, 0x00, 0x00 // keys
  };
  g_keyboardInput->setValue(neutralKeyboard, sizeof(neutralKeyboard));
  g_keyboardInput->notify();
  delay(20);
  return g_hidConnected;
}
static bool sendNeutralMouseReport() {
  if (!g_hidMode || !g_hidConnected || g_mouseInput == nullptr) {
    return false;
  }
  uint8_t neutralMouse[4] = {
    0x00, // buttons
    0x00, // dx
    0x00, // dy
    0x00  // wheel
  };
  g_mouseInput->setValue(neutralMouse, sizeof(neutralMouse));
  g_mouseInput->notify();
  delay(20);
  return g_hidConnected;
}
static void releaseAllHidInputs() {
  // Diagnostic build: intentionally no keyboard notify.
  if (!g_hidMode || !g_hidConnected || !g_mouseSubscribed || g_mouseInput == nullptr) {
    return;
  }
  uint8_t neutralMouse[4] = {0x00, 0x00, 0x00, 0x00};
  g_mouseInput->setValue(neutralMouse, sizeof(neutralMouse));
  g_mouseInput->notify();
  delay(20);
}
// Safe HID test once paired.
//
// This test intentionally sends ZERO keyboard reports. That prevents a malformed
// or interrupted keyboard notification from leaving Ctrl/Shift/Alt/GUI held.
// It also records the exact notification step in Serial before each BLE call.
void sendHidTestInjection() {
  Serial.println();
  Serial.println("[HID t] mouse-only diagnostic test");
  Serial.printf("[HID t] mode=%s connected=%s mouse_subscribed=%s\n",
                g_hidMode ? "yes" : "no",
                g_hidConnected ? "yes" : "no",
                g_mouseSubscribed ? "yes" : "no");
  Serial.flush();
  if (!g_hidMode || !g_hidConnected || g_mouseInput == nullptr) {
    Serial.println("[HID t] ABORT: HID is not connected.");
    return;
  }
  if (!g_mouseSubscribed) {
    Serial.println("[HID t] ABORT: Windows has not subscribed to the mouse report.");
    Serial.println("[HID t] Wait for '[HID] mouse notifications: SUBSCRIBED' before pressing t.");
    return;
  }
  // HOGP Report Reference descriptor identifies report ID 2. The value sent
  // through this report characteristic is the 4-byte mouse payload only:
  // [buttons][dx][dy][wheel].
  uint8_t neutralMouse[4] = {0x00, 0x00, 0x00, 0x00};
  Serial.println("[HID t] STEP 1 -> neutral mouse notify");
  Serial.flush();
  g_mouseInput->setValue(neutralMouse, sizeof(neutralMouse));
  g_mouseInput->notify();
  delay(150);
  if (!g_hidConnected) {
    Serial.println("[HID t] FAIL: disconnected after STEP 1.");
    return;
  }
  const int8_t jiggles[4][2] = {
    {  6,  0 },
    {  0,  6 },
    { -6,  0 },
    {  0, -6 }
  };
  for (uint8_t i = 0; i < 4; ++i) {
    if (!g_hidConnected || !g_mouseSubscribed) {
      Serial.printf("[HID t] FAIL: link/subscription lost before STEP %u.\n",
                    (unsigned)(i + 2));
      return;
    }
    uint8_t mouseReport[4] = {
      0x00,
      (uint8_t)jiggles[i][0],
      (uint8_t)jiggles[i][1],
      0x00
    };
    Serial.printf("[HID t] STEP %u -> mouse dx=%d dy=%d\n",
                  (unsigned)(i + 2),
                  (int)jiggles[i][0],
                  (int)jiggles[i][1]);
    Serial.flush();
    g_mouseInput->setValue(mouseReport, sizeof(mouseReport));
    g_mouseInput->notify();
    delay(150);
  }
  if (!g_hidConnected || !g_mouseSubscribed) {
    Serial.println("[HID t] FAIL: link/subscription lost before final neutral.");
    return;
  }
  Serial.println("[HID t] STEP 6 -> final neutral mouse notify");
  Serial.flush();
  g_mouseInput->setValue(neutralMouse, sizeof(neutralMouse));
  g_mouseInput->notify();
  delay(150);
  if (g_hidConnected) {
    Serial.println("[HID t] PASS: mouse-only HID notification path stayed connected.");
  } else {
    Serial.println("[HID t] FAIL: disconnected after final neutral.");
  }
  Serial.flush();
}
